#include <SoftwareSerial.h>  //MP3シリアル転送用
#include <DFPlayer_Mini_Mp3.h> //MP3再生用
#include <avr/pgmspace.h>      //ROMへのデータ退避用
#include <OneWire.h>          //温度センサーDS18B20制御用
#include <DallasTemperature.h>//温度センサーDS18B20制御用

byte val=0, aON=0 ,aOFF=0;

SoftwareSerial mySerial(11, 12); // MP3シリアルRX, TX
int output = 2;     //IR制御用ピン
#define ONE_WIRE_BUS 10 // 温度センサーのピン定義 ★5 KΩでプルアップしないと動作しないことがある★
// Setup a oneWire instance to communicate with any OneWire devices (not just Maxim/Dallas temperature ICs)
OneWire oneWire(ONE_WIRE_BUS);
// Pass our oneWire reference to Dallas Temperature.
DallasTemperature sensors(&oneWire);

//エアコンIRデータ
const PROGMEM int aircon_on[] =  {2981,2000,0,2942,334,161,44,126,41,44,38,40,43,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38,46};
const PROGMEM int aircon_off[] =  {2982,2000,0,2934,340,161,46,121,46,37,46,36,46,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36,47};

//電気点灯IRデータ→メモリ点灯に変更
//全灯　const PROGMEM int light_on[] =  {202,101,564,102,154,50,154,50,51,55,47,50,51,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47,55};
const PROGMEM int light_on[] =  {206,103,562,102,154,51,154,50,51,52,49,53,48,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48,54};

//電気消灯IRデータ
const PROGMEM int light_off[] =  {207,100,564,103,154,50,155,50,52,50,52,50,52,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48,54};

//一段階暗くするIRデータ→未使用に変更
//const PROGMEM int light_down[] =  {202,101,564,108,149,54,150,55,46,53,49,55,47,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52,50};

//一段階明るくするIRデータ→未使用に変更
//const PROGMEM int light_up[] =  {206,100,564,102,155,50,154,50,51,51,51,50,52,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52,50};

int last = 0;
unsigned long us = micros();
  
void setup() { 
  pinMode(output, OUTPUT);
  Serial.begin (9600);  //コンソール用シリアル定義
  mySerial.begin (9600);  //mp3 module用シリアル定義
  mp3_set_serial (mySerial);  //set softwareSerial for DFPlayer-mini mp3 module 
  delay(1);  //wait 1ms for mp3 module to set volume
  mp3_set_volume (30); //mp3 moduleの音量を３０（最大）に
  sensors.begin();
}


void send(int data[]) {  //エアコンIR制御
  int dataSize = 855;
  for (int cnt = 0; cnt < dataSize; cnt++) {
    unsigned long len = pgm_read_word(data + cnt)*10;
    unsigned long us = micros();
    do {
      digitalWrite(output, 1 - (cnt&1)); 
      delayMicroseconds(8); 
      digitalWrite(output, 0);
      delayMicroseconds(7);
    } while (long(us + len - micros()) > 0);
  }
}

void send_l(int data[]) {  //照明IR制御
  int dataSize = 85;
  for (int cnt = 0; cnt < dataSize; cnt++) {
    unsigned long len = pgm_read_word(data + cnt)*10;
    unsigned long us = micros();
    do {
      digitalWrite(output, 1 - (cnt&1)); 
      delayMicroseconds(8); 
      digitalWrite(output, 0);
      delayMicroseconds(7);
    } while (long(us + len - micros()) > 0);
  }
}


void loop() {
float Tc_100;  //浮動小数点型の宣言
  // call sensors.requestTemperatures() to issue a global temperature
  // request to all devices on the bus
  sensors.requestTemperatures(); // Send the command to get temperatures
  Tc_100=sensors.getTempCByIndex(0);
  Serial.println(Tc_100);
  Serial.print("aOFF");
  Serial.println(aOFF);
  Serial.print("aON:");
  Serial.println(aON);
//   delay(60000);
   delay(3000);
   
  if (Tc_100>27.5){
    if (aON==0){
  Serial.println("aircon_on");
  send(aircon_on);
  aON=1;
  aOFF=0;
    }
  }else if (Tc_100<26.5){
    if (aOFF==0){
  Serial.println("aircon_off");
   send(aircon_off);
  aON=0;
  aOFF=1;
    }  
  }

  if (Tc_100==0){
   delay(3000);
  mp3_play (4);
   delay(3000);
//   send_l(light_off);
   delay(3000);
  mp3_play (5);
   delay(3000);
   send_l(light_on);
   delay(3000);
   }   
   delay(3000);
}

